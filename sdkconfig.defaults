## sdkconfig.defaults
```kconfig
# Flash size and partition layout overrides
CONFIG_ESPTOOLPY_FLASHSIZE_4MB=y
# CONFIG_ESPTOOLPY_FLASHSIZE_2MB is not set
CONFIG_ESPTOOLPY_FLASHSIZE="4MB"

# Custom partition table
# CONFIG_PARTITION_TABLE_SINGLE_APP is not set
CONFIG_PARTITION_TABLE_CUSTOM=y
CONFIG_PARTITION_TABLE_CUSTOM_FILENAME="partitions.csv"
CONFIG_PARTITION_TABLE_FILENAME="partitions.csv"

# ============================================
# OTIMIZAÇÕES PARA REDUZIR RAM E USAR MAIS FLASH
# ============================================

# Compiler Optimization - SIZE (reduz RAM, aumenta Flash)
CONFIG_COMPILER_OPTIMIZATION_SIZE=y
CONFIG_COMPILER_OPTIMIZATION_DEBUG=n
CONFIG_COMPILER_OPTIMIZATION_PERF=n
CONFIG_COMPILER_OPTIMIZATION_ASSERTIONS_SILENT=y

# Habilitar suporte a exceções C++
CONFIG_COMPILER_CXX_EXCEPTIONS=y

# Habilitar WiFi (necessário para Supabase)
CONFIG_ESP_WIFI_ENABLED=y
CONFIG_ESP_WIFI_STATIC_RX_BUFFER_NUM=10
CONFIG_ESP_WIFI_DYNAMIC_RX_BUFFER_NUM=32
CONFIG_ESP_WIFI_TX_BUFFER_TYPE=1
CONFIG_ESP_WIFI_DYNAMIC_TX_BUFFER_NUM=32

# Desabilitar Bluetooth (não usado neste projeto)
CONFIG_BT_ENABLED=n

# Reduzir stack sizes do FreeRTOS
CONFIG_ESP_MAIN_TASK_STACK_SIZE=4096
CONFIG_ESP_SYSTEM_EVENT_TASK_STACK_SIZE=4096
CONFIG_ESP_TIMER_TASK_STACK_SIZE=2048
CONFIG_FREERTOS_IDLE_TASK_STACKSIZE=1024
CONFIG_FREERTOS_ISR_STACKSIZE=1024

# LVGL - Usar CLIB malloc ao invés de builtin (economiza RAM)
CONFIG_LV_USE_CLIB_MALLOC=y
CONFIG_LV_USE_BUILTIN_MALLOC=n
CONFIG_LV_USE_CLIB_STRING=y
CONFIG_LV_USE_BUILTIN_STRING=n
CONFIG_LV_USE_CLIB_SPRINTF=y
CONFIG_LV_USE_BUILTIN_SPRINTF=n

# Reduzir memória do LVGL (de 64KB para 32KB)
CONFIG_LV_MEM_SIZE_KILOBYTES=32

# Reduzir cache e buffers do LVGL
CONFIG_LV_CACHE_DEF_SIZE=0
CONFIG_LV_IMAGE_HEADER_CACHE_DEF_CNT=0
CONFIG_LV_DRAW_SW_SHADOW_CACHE_SIZE=0
CONFIG_LV_DRAW_SW_CIRCLE_CACHE_SIZE=2

# Desabilitar features não usadas do LVGL
CONFIG_LV_USE_LOG=n
CONFIG_LV_BUILD_EXAMPLES=n
CONFIG_LV_BUILD_DEMOS=n
CONFIG_LV_USE_OBSERVER=n
CONFIG_LV_USE_IMGFONT=n

# Desabilitar widgets não usados (mantém apenas os necessários: button, label, obj)
CONFIG_LV_USE_ANIMIMG=n
CONFIG_LV_USE_ARC=n
CONFIG_LV_USE_ARCLABEL=n
CONFIG_LV_USE_BAR=y
CONFIG_LV_USE_BUTTONMATRIX=y
CONFIG_LV_USE_CALENDAR=n
CONFIG_LV_USE_CANVAS=n
CONFIG_LV_USE_CHART=n
CONFIG_LV_USE_CHECKBOX=n
CONFIG_LV_USE_DROPDOWN=n
CONFIG_LV_USE_IMAGE=n
CONFIG_LV_USE_IMAGEBUTTON=n
CONFIG_LV_USE_KEYBOARD=y
CONFIG_LV_USE_LED=n
CONFIG_LV_USE_LINE=n
CONFIG_LV_USE_LIST=y
CONFIG_LV_USE_MENU=n
# CONFIG_LV_USE_METER foi removido no LVGL 9.4.0
CONFIG_LV_USE_MSGBOX=n
CONFIG_LV_USE_ROLLER=n
CONFIG_LV_USE_SCALE=n
CONFIG_LV_USE_SLIDER=y
CONFIG_LV_USE_SPAN=n
CONFIG_LV_USE_SPINBOX=n
CONFIG_LV_USE_SPINNER=n
CONFIG_LV_USE_SWITCH=y
CONFIG_LV_USE_TEXTAREA=y
CONFIG_LV_USE_TABLE=n
CONFIG_LV_USE_TABVIEW=n
CONFIG_LV_USE_TILEVIEW=n
CONFIG_LV_USE_WIN=n

# Habilitar fontes maiores para melhor legibilidade (14, 16, 20, 24, 26)
CONFIG_LV_FONT_MONTSERRAT_12=n
CONFIG_LV_FONT_MONTSERRAT_18=n
CONFIG_LV_FONT_MONTSERRAT_20=y
CONFIG_LV_FONT_MONTSERRAT_22=n
CONFIG_LV_FONT_MONTSERRAT_26=y
CONFIG_LV_FONT_MONTSERRAT_28=n
CONFIG_LV_FONT_MONTSERRAT_30=n
CONFIG_LV_FONT_MONTSERRAT_32=n
CONFIG_LV_FONT_MONTSERRAT_34=n
CONFIG_LV_FONT_MONTSERRAT_36=n
CONFIG_LV_FONT_MONTSERRAT_38=n
CONFIG_LV_FONT_MONTSERRAT_40=n
CONFIG_LV_FONT_MONTSERRAT_42=n
CONFIG_LV_FONT_MONTSERRAT_44=n
CONFIG_LV_FONT_MONTSERRAT_46=n
CONFIG_LV_FONT_MONTSERRAT_48=n

# Habilitar suporte UTF-8 para caracteres acentuados
CONFIG_LV_TXT_ENC_UTF8=y

# Habilitar suporte a fontes comprimidas (necessário para fontes customizadas comprimidas)
CONFIG_LV_USE_FONT_COMPRESSED=y

# Habilitar suporte a fontes grandes (necessário para fontes com muitos caracteres como range 0-65535)
CONFIG_LV_FONT_FMT_TXT_LARGE=y

# Desabilitar temas não usados
CONFIG_LV_USE_THEME_SIMPLE=n

# Desabilitar layouts não usados
CONFIG_LV_USE_GRID=n
# CONFIG_LV_USE_FLEX pode ser necessário para alguns layouts básicos, manter habilitado

# Reduzir tamanho do buffer de conversão de cores no display driver
# (será ajustado no código também)

# Habilitar HTTP Client para Supabase
CONFIG_ESP_HTTP_CLIENT_ENABLE_HTTPS=y
CONFIG_ESP_HTTP_CLIENT_ENABLE_BASIC_AUTH=y
CONFIG_MBEDTLS_CERTIFICATE_BUNDLE=y
CONFIG_ESP_TLS_USING_MBEDTLS=y
CONFIG_MBEDTLS_CERTIFICATE_BUNDLE_DEFAULT_FULL=y

# Reduzir buffers de rede (se não usar rede)
CONFIG_LWIP_MAX_SOCKETS=4
CONFIG_LWIP_MAX_ACTIVE_TCP=4
CONFIG_LWIP_MAX_LISTENING_TCP=4
CONFIG_LWIP_MAX_UDP_PCBS=4

# Desabilitar GDB stub (economiza RAM)
CONFIG_ESP_GDBSTUB_ENABLED=n

# Reduzir log level em produção (opcional - comentar se precisar debug)
# CONFIG_LOG_DEFAULT_LEVEL_WARN=y
# CONFIG_LOG_DEFAULT_LEVEL_INFO=n
# CONFIG_LOG_DEFAULT_LEVEL=2
```
